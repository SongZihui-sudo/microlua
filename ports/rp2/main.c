/*
** $Id: lua.c $
** Lua stand-alone interpreter
** See Copyright Notice in lua.h
*/

#include <stddef.h>
#define lua_c

#include "lprefix.h"

#include <stdio.h>
#include <stdlib.h>
#include <string.h>

#include <signal.h>

#include "lua.h"

#include "lauxlib.h"
#include "lualib.h"

#include "tusb.h"
#include "pico_hal.h"
#include "stdinit.h"

#if !defined( LUA_PROGNAME )
#define LUA_PROGNAME "lua"
#endif

#if !defined( LUA_INIT_VAR )
#define LUA_INIT_VAR "LUA_INIT"
#endif

#define LUA_INITVARVERSION LUA_INIT_VAR LUA_VERSUFFIX

static lua_State* globalL = NULL;

static const char* progname = LUA_PROGNAME;

#if defined( LUA_USE_POSIX ) /* { */

/*
** Use 'sigaction' when available.
*/
static void setsignal( int sig, void ( *handler )( int ) )
{
    struct sigaction sa;
    sa.sa_handler = handler;
    sa.sa_flags   = 0;
    sigemptyset( &sa.sa_mask ); /* do not mask any signal */
    sigaction( sig, &sa, NULL );
}

#else /* }{ */

#define setsignal signal

#endif /* } */

void test()
{
    int f = pico_open( "boot", lfs_mode( "w" ) );
    int bytes[]
    = {0x1b, 0x4c, 0x75, 0x61, 0x54, 0x0, 0x19, 0x93, 0xd, 0xa, 0x1a, 0xa, 0x4,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 0x0, 
0x0, 0x83, 0x80, 0x0, 0x0, 0x44, 0x0, 0x2, 0x1, 0x46, 0x0, 0x1, 0x1, 0x82, 0x4, 0x86, 0x70, 0x72, 0x69, 0x6e, 0x74, 0x4, 0x8e, 0x68, 0x65, 0x6c, 0x6c, 0x6f, 0x20, 0x77, 
0x6f, 0x72, 0x6c, 0x64, 0x21, 0xa, 0x81, 0x1, 0x0, 0x0, 0x80, 0x85, 0x1, 0x0, 0x0, 0x0, 0x0, 0x80, 0x80, 0x81, 0x85, 0x5f, 0x45, 0x4e, 0x56};
    for ( size_t i = 0; i < 116; i++ )
    {
        pico_write( f, &bytes[i], 1 );
    }
    pico_close( f );
}

/*
** Hook set by signal function to stop the interpreter.
*/
static void lstop( lua_State* L, lua_Debug* ar )
{
    ( void )ar;                   /* unused arg. */
    lua_sethook( L, NULL, 0, 0 ); /* reset hook */
    luaL_error( L, "interrupted!" );
}

/*
** Function to be called at a C signal. Because a C signal cannot
** just change a Lua state (as there is no proper synchronization),
** this function only sets a hook that, when called, will stop the
** interpreter.
*/
static void laction( int i )
{
    int flag = LUA_MASKCALL | LUA_MASKRET | LUA_MASKLINE | LUA_MASKCOUNT;
    setsignal( i, SIG_DFL ); /* if another SIGINT happens, terminate process */
    lua_sethook( globalL, lstop, flag, 1 );
}

/*
** Prints an error message, adding the program name in front of it
** (if present)
*/
static void l_message( const char* pname, const char* msg )
{
    if ( pname )
        lua_writestringerror( "%s: ", pname );
    lua_writestringerror( "%s\n", msg );
}

/*
** Check whether 'status' is not OK and, if so, prints the error
** message on the top of the stack. It assumes that the error object
** is a string, as it was either generated by Lua or by 'msghandler'.
*/
static int report( lua_State* L, int status )
{
    if ( status != LUA_OK )
    {
        const char* msg = lua_tostring( L, -1 );
        l_message( progname, msg );
        lua_pop( L, 1 ); /* remove message */
    }
    return status;
}

/*
** Message handler used to run all chunks
*/
static int msghandler( lua_State* L )
{
    const char* msg = lua_tostring( L, 1 );
    if ( msg == NULL )
    {                                               /* is error object not a string? */
        if ( luaL_callmeta( L, 1, "__tostring" ) && /* does it have a metamethod */
             lua_type( L, -1 ) == LUA_TSTRING )     /* that produces a string? */
            return 1;                               /* that is the message */
        else
            msg = lua_pushfstring( L, "(error object is a %s value)", luaL_typename( L, 1 ) );
    }
    luaL_traceback( L, L, msg, 1 ); /* append a standard traceback */
    return 1;                       /* return the traceback */
}

/*
** Interface to 'lua_pcall', which sets appropriate message function
** and C-signal handler. Used to run all chunks.
*/
static int docall( lua_State* L, int narg, int nres )
{
    int status;
    int base = lua_gettop( L ) - narg;  /* function index */
    lua_pushcfunction( L, msghandler ); /* push message handler */
    lua_insert( L, base );              /* put it under function and args */
    globalL = L;                        /* to be available to 'laction' */
    setsignal( SIGINT, laction );       /* set C-signal handler */
    status = lua_pcall( L, narg, nres, base );
    setsignal( SIGINT, SIG_DFL ); /* reset C-signal handler */
    lua_remove( L, base );        /* remove message handler from the stack */
    return status;
}

static void print_version( void )
{
    lua_writestring( LUA_COPYRIGHT, strlen( LUA_COPYRIGHT ) );
    lua_writeline();
}

/*
** {==================================================================
** Read-Eval-Print Loop (REPL)
** ===================================================================
*/

#if !defined( LUA_PROMPT )
#define LUA_PROMPT "> "
#define LUA_PROMPT2 ">> "
#endif

#if !defined( LUA_MAXINPUT )
#define LUA_MAXINPUT 512
#endif

/*
** lua_stdin_is_tty detects whether the standard input is a 'tty' (that
** is, whether we're running lua interactively).
*/
#if !defined( lua_stdin_is_tty ) /* { */

#if defined( LUA_USE_POSIX ) /* { */

#include <unistd.h>
#define lua_stdin_is_tty() isatty( 0 )

#elif defined( LUA_USE_WINDOWS ) /* }{ */

#include <io.h>
#include <windows.h>

#define lua_stdin_is_tty() _isatty( _fileno( stdin ) )

#else                        /* }{ */

/* ISO C definition */
#define lua_stdin_is_tty() 1 /* assume stdin is a tty */

#endif /* } */

#endif /* } */

/*
** lua_readline defines how to show a prompt and then read a line from
** the standard input.
** lua_saveline defines how to "save" a read line in a "history".
** lua_freeline defines how to free a line read by lua_readline.
*/
#if !defined( lua_readline ) /* { */

#if defined( LUA_USE_READLINE ) /* { */

#include <readline/readline.h>
#include <readline/history.h>
#define lua_initreadline( L ) ( ( void )L, rl_readline_name = "lua" )
#define lua_readline( L, b, p ) ( ( void )L, ( ( b ) = readline( p ) ) != NULL )
#define lua_saveline( L, line ) ( ( void )L, add_history( line ) )
#define lua_freeline( L, b ) ( ( void )L, free( b ) )

#else /* }{ */

#define lua_initreadline( L ) ( ( void )L )
#define lua_saveline( L, line )                                                            \
    {                                                                                      \
        ( void )L;                                                                         \
        ( void )line;                                                                      \
    }
#define lua_freeline( L, b )                                                               \
    {                                                                                      \
        ( void )L;                                                                         \
        ( void )b;                                                                         \
    }

#endif /* } */

#endif /* } */

/*
** Return the string to be used as a prompt by the interpreter. Leave
** the string (or nil, if using the default value) on the stack, to keep
** it anchored.
*/
static const char* get_prompt( lua_State* L, int firstline )
{
    if ( lua_getglobal( L, firstline ? "_PROMPT" : "_PROMPT2" ) == LUA_TNIL )
        return ( firstline ? LUA_PROMPT : LUA_PROMPT2 ); /* use the default */
    else
    { /* apply 'tostring' over the value */
        const char* p = luaL_tolstring( L, -1, NULL );
        lua_remove( L, -2 ); /* remove original value */
        return p;
    }
}

/* mark in error messages for incomplete statements */
#define EOFMARK "<eof>"
#define marklen ( sizeof( EOFMARK ) / sizeof( char ) - 1 )

/*
** Check whether 'status' signals a syntax error and the error
** message at the top of the stack ends with the above mark for
** incomplete statements.
*/
static int incomplete( lua_State* L, int status )
{
    if ( status == LUA_ERRSYNTAX )
    {
        size_t lmsg;
        const char* msg = lua_tolstring( L, -1, &lmsg );
        if ( lmsg >= marklen && strcmp( msg + lmsg - marklen, EOFMARK ) == 0 )
        {
            lua_pop( L, 1 );
            return 1;
        }
    }
    return 0; /* else... */
}

int readLine( const char* promt, unsigned char* buffer )
{
    fputs( promt, stdout );
    fflush( stdout );
    fflush( stdin );
    unsigned char u, *p;
    for ( p = buffer, u = getchar(); p - buffer < LUA_MAXINPUT; u = getchar() )
    {
        putchar( *p++ = u );
        if ( u == '\r' )
        {
            putchar( *p++ = '\n' );
            break;
        }
    }
    *p = 0;
    return 1;
}
/*
** Prompt the user, read a line, and push it into the Lua stack.
*/
static int pushline( lua_State* L, int firstline )
{
    char buffer[LUA_MAXINPUT];
    char* b = buffer;
    size_t l;
    const char* prmt = get_prompt( L, firstline );
    int readstatus   = readLine( prmt, b );
    if ( readstatus == 0 )
        return 0;    /* no input (prompt will be popped by caller) */
    lua_pop( L, 1 ); /* remove prompt */
    l = strlen( b );
    if ( l > 0 && b[l - 1] == '\n' )              /* line ends with newline? */
        b[--l] = '\0';                            /* remove it */
    if ( firstline && b[0] == '=' )               /* for compatibility with 5.2, ... */
        lua_pushfstring( L, "return %s", b + 1 ); /* change '=' to 'return' */
    else
        lua_pushlstring( L, b, l );
    lua_freeline( L, b );
    return 1;
}

/*
** Try to compile line on the stack as 'return <line>;'; on return, stack
** has either compiled chunk or original line (if compilation failed).
*/
static int addreturn( lua_State* L )
{
    const char* line    = lua_tostring( L, -1 ); /* original line */
    const char* retline = lua_pushfstring( L, "return %s;", line );
    int status          = luaL_loadbuffer( L, retline, strlen( retline ), "=stdin" );
    if ( status == LUA_OK )
    {
        lua_remove( L, -2 );         /* remove modified line */
        if ( line[0] != '\0' )       /* non empty? */
            lua_saveline( L, line ); /* keep history */
    }
    else
        lua_pop( L, 2 ); /* pop result from 'luaL_loadbuffer' and modified line */
    return status;
}

/*
** Read multiple lines until a complete Lua statement
*/
static int multiline( lua_State* L )
{
    for ( ;; )
    { /* repeat until gets a complete statement */
        size_t len;
        const char* line = lua_tolstring( L, 1, &len );               /* get what it has */
        int status       = luaL_loadbuffer( L, line, len, "=stdin" ); /* try it */
        if ( !incomplete( L, status ) || !pushline( L, 0 ) )
        {
            lua_saveline( L, line ); /* keep history */
            return status;           /* cannot or should not try to add continuation line */
        }
        lua_pushliteral( L, "\n" ); /* add newline... */
        lua_insert( L, -2 );        /* ...between the two lines */
        lua_concat( L, 3 );         /* join them */
    }
}

/*
** Read a line and try to load (compile) it first as an expression (by
** adding "return " in front of it) and second as a statement. Return
** the final status of load/call with the resulting function (if any)
** in the top of the stack.
*/
static int loadline( lua_State* L )
{
    int status;
    lua_settop( L, 0 );
    if ( !pushline( L, 1 ) )
        return -1;                               /* no input */
    if ( ( status = addreturn( L ) ) != LUA_OK ) /* 'return ...' did not work? */
        status = multiline( L ); /* try as command, maybe with continuation lines */
    lua_remove( L, 1 );          /* remove line from the stack */
    lua_assert( lua_gettop( L ) == 1 );
    return status;
}

/*
** Prints (calling the Lua 'print' function) any values on the stack
*/
static void l_print( lua_State* L )
{
    int n = lua_gettop( L );
    if ( n > 0 )
    { /* any result to be printed? */
        luaL_checkstack( L, LUA_MINSTACK, "too many results to print" );
        lua_getglobal( L, "print" );
        lua_insert( L, 1 );
        if ( lua_pcall( L, n, 0, 0 ) != LUA_OK )
            l_message( progname,
                       lua_pushfstring( L, "error calling 'print' (%s)", lua_tostring( L, -1 ) ) );
    }
}

/*
** Do the REPL: repeatedly read (load) a line, evaluate (call) it, and
** print any results.
*/
static void doREPL( lua_State* L )
{
    int status;
    const char* oldprogname = progname;
    progname                = NULL; /* no 'progname' on errors in interactive mode */
    lua_initreadline( L );
    while ( ( status = loadline( L ) ) != -1 )
    {
        if ( status == LUA_OK )
            status = docall( L, 0, LUA_MULTRET );
        if ( status == LUA_OK )
            l_print( L );
        else
            report( L, status );
    }
    lua_settop( L, 0 ); /* clear stack */
    lua_writeline();
    progname = oldprogname;
}

static int dofilecont( lua_State* L, int d1, lua_KContext d2 )
{
    ( void )d1;
    ( void )d2; /* only to match 'lua_Kfunction' prototype */
    return lua_gettop( L ) - 1;
}

static int luaB_dofile( lua_State* L, const char* fname )
{
    lua_settop( L, 1 );
    if ( luai_unlikely( luaL_loadfile( L, fname ) != LUA_OK ) )
        return lua_error( L );
    lua_callk( L, 0, LUA_MULTRET, 0, dofilecont );
    return dofilecont( L, 0, 0 );
}


/* }================================================================== */

/*
** Main body of stand-alone interpreter (to be called in protected mode).
** Reads the options and handles them all.
*/
static int pmain( lua_State* L )
{
    luaL_checkversion( L );       /* check that interpreter has correct version */
    luaL_openlibs( L );           /* open standard libraries */
    lua_gc( L, LUA_GCRESTART );   /* start GC... */
    lua_gc( L, LUA_GCGEN, 0, 0 ); /* ...in generational mode */
#ifndef MINIMIZE_NO_COMPILER
    if ( lua_stdin_is_tty() )
    { /* running in interactive mode? */
        print_version();
        doREPL( L ); /* do read-eval-print loop */
    }
#else
    luaB_dofile(L, "boot");
#endif
    lua_pushboolean( L, 1 ); /* signal no errors */
    return 1;
}

static int initialize_filesystem()
{
    if ( pico_mount( true ) < 0 )
    {
        printf( "Mount failed\n" );
        return -1;
    }
    struct pico_fsstat_t stat;
    pico_fsstat( &stat );
    printf( "FS: blocks %d, block size %d, used %d\n",
            ( int )stat.block_count,
            ( int )stat.block_size,
            ( int )stat.blocks_used );
    test();
    return 0;
}

int main( int argc, char** argv )
{
    stdio_init();
    while ( !tud_cdc_connected() )
    {
        sleep_ms( 100 );
    }
    initialize_filesystem();
    int status, result;
    lua_State* L = luaL_newstate(); /* create state */
    if ( L == NULL )
    {
        l_message( argv[0], "cannot create state: not enough memory" );
        return EXIT_FAILURE;
    }
    lua_gc( L, LUA_GCSTOP );          /* stop GC while building state */
    lua_pushcfunction( L, &pmain );   /* to call 'pmain' in protected mode */
    lua_pushinteger( L, argc );       /* 1st argument */
    lua_pushlightuserdata( L, argv ); /* 2nd argument */
    status = lua_pcall( L, 2, 1, 0 ); /* do the call */
    result = lua_toboolean( L, -1 );  /* get result */
    report( L, status );
    lua_close( L );
    return ( result && status == LUA_OK ) ? EXIT_SUCCESS : EXIT_FAILURE;
}
